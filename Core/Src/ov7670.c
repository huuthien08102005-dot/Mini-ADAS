#include "ov7670.h"

/************************************************
                OLD PIXEL
************************************************/

int old_pixel = 0;

/************************************************
                DELAY
************************************************/

void OV7670_Delay(void)
{
    for(int i=0;i<1000;i++);
}

/************************************************
            SCCB START
************************************************/

void SCCB_Start(void)
{
    GPIOB->ODR |= (1<<10); //SDA

    GPIOB->ODR |= (1<<9); //SCL

    OV7670_Delay();

    GPIOB->ODR &= ~(1<<10);

    OV7670_Delay();

    GPIOB->ODR &= ~(1<<9);
}

/************************************************
            SCCB STOP
************************************************/

void SCCB_Stop(void)
{
    GPIOB->ODR &= ~(1<<10);

    GPIOB->ODR |= (1<<9);

    OV7670_Delay();

    GPIOB->ODR |= (1<<10);
}

/************************************************
            SCCB WRITE BYTE
************************************************/

void SCCB_WriteByte(uint8_t data)
{
    for(int i=0;i<8;i++)
    {
        if(data & (1<<7))
        {
            GPIOB->ODR |= (1<<10); //Kéo SDA lên high
        }
        else
        {
            GPIOB->ODR &= ~(1<<10); //Kéo SDA xuống low
        }

        GPIOB->ODR |= (1<<9); //Camera đọc dữ liệu

        OV7670_Delay();

        GPIOB->ODR &= ~(1<<9); //Chuẩn bị dịch bit

        data <<= 1;
    }
}

/************************************************
            SCCB WRITE
************************************************/

void SCCB_Write(uint8_t reg,
                uint8_t data)
{
    SCCB_Start();

    SCCB_WriteByte(0x42);

    SCCB_WriteByte(reg);

    SCCB_WriteByte(data);

    SCCB_Stop();
}

/************************************************
            XCLK INIT
            PA8 = TIM1_CH1
************************************************/

void XCLK_Init(void)
{
    /********************************************
        GPIOA CLOCK
    ********************************************/

    RCC->AHB1ENR |= (1<<0);

    /********************************************
        TIM1 CLOCK
    ********************************************/

    RCC->APB2ENR |= (1<<0);

    /********************************************
        PA8 Alternate Function
    ********************************************/

    GPIOA->MODER &= ~(3<<16);

    GPIOA->MODER |= (2<<16);

    /********************************************
        AF1 = TIM1
    ********************************************/

    GPIOA->AFR[1] &= ~(15<<0);

    GPIOA->AFR[1] |= (1<<0);

    /********************************************
        PWM CONFIG
    ********************************************/

    TIM1->PSC = 0;

    TIM1->ARR = 3;

    TIM1->CCR1 = 2;

    /********************************************
        PWM MODE 1
    ********************************************/

    TIM1->CCMR1 |= (6<<4);

    /********************************************
        ENABLE OUTPUT
    ********************************************/

    TIM1->CCER |= (1<<0);

    /********************************************
        MAIN OUTPUT ENABLE
    ********************************************/

    TIM1->BDTR |= (1<<15);

    /********************************************
        TIMER ENABLE
    ********************************************/

    TIM1->CR1 |= (1<<0);
}

/************************************************
            OV7670 INIT
************************************************/

void OV7670_Init(void)
{
    /********************************************
        GPIOA CLOCK
    ********************************************/

    RCC->AHB1ENR |= (1<<0);

    /********************************************
        GPIOB CLOCK
    ********************************************/

    RCC->AHB1ENR |= (1<<1);

    /********************************************
        PB9 = SCL OUTPUT
    ********************************************/

    GPIOB->MODER &= ~(3<<18);

    GPIOB->MODER |= (1<<18);

    /********************************************
        PB10 = SDA OUTPUT
    ********************************************/

    GPIOB->MODER &= ~(3<<20);

    GPIOB->MODER |= (1<<20);

    /********************************************
        PB2 = VSYNC INPUT
    ********************************************/

    GPIOB->MODER &= ~(1<<4);

    /********************************************
        PB12 = PCLK INPUT
    ********************************************/

    GPIOB->MODER &= ~(3<<24);

    /********************************************
        PB8 = D7 INPUT
    ********************************************/

    GPIOB->MODER &= ~(3<<16);

    /********************************************
        START XCLK
    ********************************************/

    XCLK_Init();

    /********************************************
        RESET CAMERA
    ********************************************/

    SCCB_Write(0x12, 0x80);

    for(int i=0;i<100000;i++);

    /********************************************
        RGB MODE
    ********************************************/

    SCCB_Write(0x12, 0x04);
}

int OV7670_MotionDetect(void)
{
    volatile uint32_t timeout_counter;
    timeout_counter = 2000;
    while(!(GPIOB->IDR & (1 << 12)))
    {
        timeout_counter--;
        if(timeout_counter == 0)
        {
            return 0;
        }
    }
    int current_pixel = (GPIOB->IDR & (1 << 8));
    if (current_pixel != old_pixel)
    {
        timeout_counter = 2000;
        while(GPIOB->IDR & (1 << 12))
        {
            timeout_counter--;
            if(timeout_counter == 0) return 0;
        }
        timeout_counter = 2000;
        while(!(GPIOB->IDR & (1 << 12)))
        {
            timeout_counter--;
            if(timeout_counter == 0) return 0;
        }
        int confirm_pixel = (GPIOB->IDR & (1 << 8));

        if(confirm_pixel == current_pixel)
        {
            old_pixel = current_pixel;
            return 1;        }
    }

    old_pixel = current_pixel;
    return 0;
}
